VERSION ""

NS_ :

BS_:

BU_: ECU Gateway

BO_ 256 EngineData: 8 ECU
 SG_ EngineSpeed : 0|16@1+ (0.25,0) [0|8000] "rpm" Gateway
 SG_ CoolantTemp : 16|8@1+ (1,-40) [-40|215] "degC" Gateway

BO_ 512 VehicleSpeed: 8 ECU
 SG_ VehicleSpeed : 0|16@1+ (0.01,0) [0|300] "km/h" Gateway

BO_ 768 BrakeStatus: 8 ECU
 SG_ BrakePedal : 0|1@1+ (1,0) [0|1] "" Gateway

BO_ 784 LightControl: 8 Gateway
 SG_ BrakeLightCmd : 0|1@1+ (1,0) [0|1] "" ECU

BA_DEF_ BO_ "GenMsgCycleTime" INT 0 65535;
BA_DEF_DEF_ "GenMsgCycleTime" 0;
BA_ "GenMsgCycleTime" BO_ 256 10;
BA_ "GenMsgCycleTime" BO_ 512 20;
BA_ "GenMsgCycleTime" BO_ 768 50;
BA_ "GenMsgCycleTime" BO_ 784 50;
